## boards/shields/ixx/Kconfig.shield
```kconfig
# Copyright (c) 2020 The ZMK Contributors
# SPDX-License-Identifier: MIT

config SHIELD_IXX_LEFT
    def_bool $(shields_list_contains,thewolfkb_left)

config SHIELD_IXX_RIGHT
    def_bool $(shields_list_contains,thewolfkb_right)
```

## boards/shields/thewolfkb/Kconfig.defconfig
```kconfig
if SHIELD_THEWOLFKB_LEFT

config ZMK_KEYBOARD_NAME
    default "thewolfkb"

config ZMK_SPLIT_ROLE_CENTRAL
    default y

endif

if SHIELD_THEWOLFKB_LEFT || SHIELD_THEWOLFKB_RIGHT

config ZMK_SPLIT
    default y

endif
```

## config/boards/shields/Kconfig.defconfig
```kconfig
if THEWOLFKB_LEFT

config ZMK_KEYBOARD_NAME
    default "TheWolfKB"

config ZMK_SPLIT_ROLE_CENTRAL
    default y

endif

if THEWOLFKB_LEFT || THEWOLFKB_RIGHT

config ZMK_SPLIT
    default y

endif
```

## config/boards/shields/Kconfig.shield
```kconfig
# Copyright (c) 2020 The ZMK Contributors
# SPDX-License-Identifier: MIT

config SHIELD_THEWOLFKB_LEFT
    def_bool $(shields_list_contains,thewolfkb_left)

config SHIELD_THEWOLFKB_RIGHT
    def_bool $(shields_list_contains,thewolfkb_right)
```
