/*
 * Copyright (c) 2020 The ZMK Contributors
 *
 * SPDX-License-Identifier: MIT
 */

#include "thewolfkb.dtsi"

/ {
    kscan1: kscan_direct {
        compatible = "zmk,kscan-gpio-direct";
        input-gpios 
            = <&pro_micro 15 (GPIO_ACTIVE_LOW)>,// move up
              <&pro_micro 18 (GPIO_ACTIVE_LOW)>,// move down
              <&pro_micro 19 (GPIO_ACTIVE_LOW)>,// move left
              <&pro_micro 20 (GPIO_ACTIVE_LOW)>,// move right
              <&pro_micro 21 (GPIO_ACTIVE_LOW)>;// right click
    };

    kscan2:kscan_matrix {
        compatible = "zmk,kscan-gpio-matrix";
        diode-direction = "col2row";
        wakeup-source;
        
    col-gpios
        = <&pro_micro 5 (GPIO_ACTIVE_HIGH)>
        , <&pro_micro 6 (GPIO_ACTIVE_HIGH)>
        , <&pro_micro 7 (GPIO_ACTIVE_HIGH)>
        , <&pro_micro 8 (GPIO_ACTIVE_HIGH)>
        , <&pro_micro 9 (GPIO_ACTIVE_HIGH)>
        ;

    row-gpios
        = <&pro_micro 1 (GPIO_ACTIVE_HIGH | GPIO_PULL_DOWN)>
        , <&pro_micro 0 (GPIO_ACTIVE_HIGH | GPIO_PULL_DOWN)>
        , <&pro_micro 2 (GPIO_ACTIVE_HIGH | GPIO_PULL_DOWN)>
        , <&pro_micro 3 (GPIO_ACTIVE_HIGH | GPIO_PULL_DOWN)>
        ;
    };
};